## GPIOs/KY_038_Clap_Sensor/drivers/sensor/emade9000/Kconfig
```kconfig
# EMINV energy meter interface Sensor configuration options
# Copyright (c) 2024 ubaid
# SPDX-License-Identifier: Apache-2.0

menuconfig EMADE9000
	bool "EMADE9000 energy meter Sensor"
	default n
	depends on SPI
	depends on GPIO
	help
	  Enable driver for the EMADE9000 energy meter
```

## GPIOs/KY_038_Clap_Sensor/dts/bindings/sensor/zephyr,emade9000.yaml
```yaml
# Copyright (c) 2024 unknow
# SPDX-License-Identifier: Apache-2.0

description: ade9000 energy meter Sensor

compatible: "zephyr,emade9000"

include: spi-device.yaml

properties:
  cf4-gpios:
    type: phandle-array
    required: true
    description: |
      This property specifies the connection for CF4, because the
      Zephyr driver maps all interrupts to CF4.  The signal defaults
      to output low when produced by the sensor
  
  irq1-gpios:
    type: phandle-array
    required: true
    description: |
      This property specifies the connection for IRQ1, because the
      Zephyr driver maps all interrupts to IRQ1.  The signal defaults
      to output low when produced by the sensor

on-bus: spi
```
